## ModbusDiag/firmware/sdkconfig.defaults
```kconfig
# ESP-IDF配置默认值 - ModbusDiag
CONFIG_IDF_TARGET="esp32s3"
CONFIG_IDF_TARGET_ESP32S3=y

# 内存
CONFIG_ESP32S3_DEFAULT_CPU_FREQ_MHZ_240=y
CONFIG_ESP32S3_DATA_CACHE_64KB=y
CONFIG_ESP32S3_INSTRUCTION_CACHE_64KB=y
CONFIG_SPIRAM_MODE_QUAD=y
CONFIG_SPIRAM_TYPE_AUTO=y
CONFIG_SPIRAM_SPEED_80M=y
CONFIG_SPIRAM=y
CONFIG_SPIRAM_USE_CAPS_ALLOC=y
CONFIG_SPIRAM_MALLOC_ALWAYSINTERNAL_INFER_SIZE=16384

# 分区表
CONFIG_PARTITION_TABLE_CUSTOM=n
CONFIG_PARTITION_TABLE_SINGLE_APP=y

# 编译器优化
CONFIG_COMPILER_OPTIMIZATION_DEFAULT=y

# FreeRTOS
CONFIG_FREERTOS_HZ=1000
CONFIG_FREERTOS_TICK_SUPPORT_CORETIMER=y
CONFIG_FREERTOS_CORETIMER_SYSTICK_LVL1=y
CONFIG_FREERTOS_TASK_FUNCTION_WRAPPER=y

# 日志
CONFIG_LOG_DEFAULT_LEVEL_INFO=y
CONFIG_LOG_MAXIMUM_LEVEL=ESP_LOG_INFO

# WiFi
CONFIG_ESP_WIFI_STATIC_TX_BUFFER=y
CONFIG_ESP_WIFI_DYNAMIC_TX_BUFFER=y
CONFIG_ESP_WIFI_TX_BUFFER_TYPE=1
CONFIG_ESP_WIFI_DYNAMIC_RX_BUFFER_NUM=32
CONFIG_ESP_WIFI_STATIC_RX_BUFFER_NUM=10
CONFIG_ESP_WIFI_STA_DISCONNECTED_PM_ENABLE=y

# LWIP
CONFIG_LWIP_LOCAL_HOSTNAME="ModbusDiag"

# SPI Flash
CONFIG_ESPTOOLPY_FLASHSIZE_16MB=y

# 调试
CONFIG_ESP_DEBUG_OCDAWARE=n
CONFIG_OPTIMIZATION_ASSERTIONS_SILENT=y

# LVGL使用PSRAM
CONFIG_LV_MEM_CUSTOM=y
CONFIG_LV_MEMCPY_MEMSET_STD=y
CONFIG_LV_DPI=100
CONFIG_LV_COLOR_DEPTH_16=y
CONFIG_LV_FONT_MONTSERRAT_14=y
CONFIG_LV_FONT_MONTSERRAT_20=y
CONFIG_LV_USE_THEME_DEFAULT=y
```
